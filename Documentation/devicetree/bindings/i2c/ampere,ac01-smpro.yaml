## Documentation/devicetree/bindings/i2c/ampere,ac01-smpro.yaml
```yaml
# SPDX-License-Identifier: (GPL-2.0 OR BSD-2-Clause)
%YAML 1.2
---
$id: "http://devicetree.org/schemas/i2c/ampere,ac01-smpro.yaml#"
$schema: "http://devicetree.org/meta-schemas/core.yaml#"

title: Ampere SMpro controller Device Tree Bindings

maintainers:
  - thu@os.amperecomputing.com

allOf:
  - $ref: /schemas/i2c/i2c-controller.yaml#

properties:
  compatible:
    const: ampere,ac01-smpro

  reg:
    maxItems: 1

required:
  - compatible
  - reg

examples:
  - |
        smpro@4f {
                compatible = "ampere,ac01-smpro";
                reg = <0x4f>;
        };
```

## Documentation/devicetree/bindings/i2c/ampere,smpro.yaml
```yaml
# SPDX-License-Identifier: (GPL-2.0 OR BSD-2-Clause)
%YAML 1.2
---
$id: "http://devicetree.org/schemas/i2c/ampere,smpro.yaml#"
$schema: "http://devicetree.org/meta-schemas/core.yaml#"

title: Ampere SMpro controller Device Tree Bindings

maintainers:
  - thu@os.amperecomputing.com

allOf:
  - $ref: /schemas/i2c/i2c-controller.yaml#

properties:
  compatible:
    const: ampere,smpro

  reg:
    maxItems: 1

required:
  - compatible
  - reg

examples:
  - |
        smpro@4f {
                compatible = "ampere,smpro";
                reg = <0x4f>;
        };
```

## Documentation/devicetree/bindings/mailbox/aspeed-mbox.txt
```
ASpeed Mailbox Driver
=====================

The ASpeed mailbox allows for communication between different
processors. The mailbox on the ASpeed ast2400 and ast2500 is a set of
16 single byte data registers along with interrupt and configuration
registers directly on the SoC. These are memory mapped on the aspeed
and can be accessed via the SuperIO registers on the other processor.

Device Node:
============
This represents the mailbox on the Soc.

As the mailbox registers sit on the LPC bus, it makes most sense for
the device to be within the LPC host node. See
Documentation/devicetree/bindings/mfd/aspeed-lpc.txt for more
information. This does not have to be the case, provided the reg
property can give the full address of the mbox registers.

Required Properties:
--------------------
- compatible:	Should be one of the following,
				"aspeed,ast2400-mbox" for ast2400 SoCs
				"aspeed,ast2500-mbox" for ast2500 SoCs

- reg:			Contains the mailbox address register range (base
				address and length). Keeping in mind that if the node
				exists within the LPC host node and that base is
				relative to that.

- interrupts:	Contains interrupt information for the mailbox device.

- #mbox-cells:	Common property, should be 1.

Example:
--------

mbox: mbox@180 {
	compatible = "aspeed,ast2400-mbox";
	reg = <0x180 0x5c>;
	interrupts = <46>;
	#mbox-cells = <1>;
};
```

## Documentation/devicetree/bindings/misc/aspeed-lpc-ctrl.txt
```
ASpeed LPC Control
==================
This binding defines the LPC control for ASpeed SoCs. Partitions of
the LPC bus can be access by other processors on the system, address
ranges on the bus can map accesses from another processor to regions
of the ASpeed SoC memory space.

Reserved Memory:
================
The driver provides functionality to map the LPC bus to a region of
ASpeed ram. A phandle to a reserved memory node must be provided so
that the driver can safely use this region.

Flash:
======
The driver provides functionality to unmap the LPC bus from ASpeed
RAM, historically the default mapping has been to the SPI flash
controller on the ASpeed SoC, a phandle to this node should be
supplied.

Device Node:
============

As LPC bus configuration registers are at the start of the LPC bus
memory space, it makes most sense for the device to be within the LPC
host node. See Documentation/devicetree/bindings/mfd/aspeed-lpc.txt
for more information. This does not have to be the case, provided the
reg property can give the full address of the LPC bus.

Required properties:
--------------------

- compatible:		"aspeed,ast2400-lpc-ctrl" for ASpeed ast2400 SoCs
					"aspeed,ast2500-lpc-ctrl" for ASpeed ast2500 SoCs

- reg:				Location and size of the configuration registers
					for the LPC bus. Note that if the device node is
					within the LPC host node then base is relative to
					that.

- memory-region:	phandle of the reserved memory region
- flash:			phandle of the SPI flash controller

Example:
--------

reserved-memory {
	#address-cells = <1>;
	#size-cells = <1>;
	ranges;

	...

	flash_memory: region@54000000 {
		compatible = "aspeed,ast2400-lpc-ctrl";
		no-map;
		reg = <0x54000000 0x04000000>; /* 64M */
	};
};

host_pnor: spi@1e630000 {
	reg = < 0x1e630000 0x18
			0x30000000 0x02000000 >;
	#address-cells = <1>;
	#size-cells = <0>;
	compatible = "aspeed,ast2400-smc";

	...

};

lpc-ctrl@0 {
	compatible = "aspeed,ast2400-lpc-ctrl";
	memory-region = <&flash_memory>;
	flash = <&host_pnor>;
	reg = <0x0 0x80>;
};
```

## drivers/fsi/Kconfig
```kconfig
#
# FSI subsystem
#

menu "FSI support"

config FSI
	tristate "FSI support"
	---help---
	  FSI - the FRU Support Interface - is a simple bus for low-level
	  access to POWER-based hardware.

if FSI

config FSI_MASTER_GPIO
	tristate "GPIO-based FSI master"
	depends on FSI && GPIOLIB
	---help---
	This option enables a FSI master driver using GPIO lines.

config FSI_SBEFIFO
	tristate "SBEFIFO FSI client device driver"
	depends on FSI
	---help---
	This option enables an FSI based SBEFIFO device driver.

if FSI_SBEFIFO

config OCCFIFO
	tristate "OCC SBEFIFO client device driver"
	depends on FSI_SBEFIFO
	---help---
	This option enables an FSI based OCC driver using the SBEFIFO.

endif

config FSI_SCOM
	tristate "SCOM FSI client device driver"
	depends on FSI
	---help---
	This option enables an FSI based SCOM device driver.

config FSI_I2C
	tristate "I2C FSI client device driver"
	depends on FSI
	---help---
	This option enables an FSI based I2C device driver.

endif

endmenu
```

## drivers/hwmon/occ/Kconfig
```kconfig
#
# On-Chip Controller configuration
#

config SENSORS_OCC_P9_SBE
	bool "POWER9 OCC via SBE"
	depends on OCCFIFO
	help
	  If you say yes here you get support for monitoring the POWER9
	  processor sensors via the OCC, from a service processor, over SBE
	  engine on FSI bus.
```
